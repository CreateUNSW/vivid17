#ifdef __cplusplus
extern "C" {
#endif
int _isatty (){
  return 0;
}
int _fstat (){
  return 1;
}
#ifdef __cplusplus
}
#endif
#include "malloc.h"

#include "FastLED.h"
#include "Graph.hpp"


// IO/Hardware config
//--------------------------------------------------
#define NUM_PINS 1
// ALL THESE ARE FOR THE TOP ETHERNET JACK
#define DATA_PIN0 2 // Green wire
#define DATA_PIN1 4 // Blue wire
#define DATA_PIN2 6 // Green wire
#define DATA_PIN3 8 // Brown wire
#define CLOCK_PIN 13

#define SENSOR0 0

#define LED_TYPE WS2812
#define BRIGHTNESS 255
//--------------------------------------------------


// Crystals/LEDs config
//--------------------------------------------------
#define NUM_CRYSTALS 291
#define CRYSTALS_PER_PIN 17 // Total crystal designs
#define LEDS_PER_PIN 50 // Number of LEDs per strip
//--------------------------------------------------


CRGB leds[LEDS_PER_PIN * NUM_PINS];

uint16_t firstLED[NUM_CRYSTALS] = {0,5,10,13,16,21,27,33,40,45,48,54,58,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1534,1541};
uint16_t lastLED[NUM_CRYSTALS] = {4,9,12,15,20,26,32,39,44,47,53,57,66,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1540,1547};

//-----------------------------------------------------
// DISABLED TO SAVE MEMORY (USE "wing1" ARRAYS INSTEAD)
//-----------------------------------------------------
//#define WING_1_SIZE 183
//#define WING_MASK_1_SIZE 109
//#define WING_2_SIZE 209
//#define WING_MASK_2_SIZE 82
//#define WING_3_SIZE 208
//#define WING_MASK_3_SIZE 83
//#define WING_4_SIZE 202
//#define WING_MASK_4_SIZE 89
//#define WING_5_SIZE 203
//#define WING_MASK_5_SIZE 88
//uint16_t wingMap1[WING_1_SIZE] = {0,1,2,7,8,9,10,12,13,14,15,16,17,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289,290};
//uint16_t wingMask1[WING_MASK_1_SIZE] = {3,4,5,6,11,36,37,38,39,40,41,42,43,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270,};
//uint16_t wingMap2[WING_2_SIZE] = {0,5,6,7,8,9,10,11,12,13,14,15,16,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289,290};
//uint16_t wingMask2[WING_MASK_2_SIZE] = {1,2,3,4,34,35,36,37,38,39,40,41,42,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262,263};
//uint16_t wingMap3[WING_3_SIZE] = {2,3,4,5,6,7,8,9,10,11,12,13,14,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289,290};
//uint16_t wingMask3[WING_MASK_3_SIZE] = {0,1,33,34,35,36,38,39,40,41,42,48,50,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260,263};
//uint16_t wingMap4[WING_4_SIZE] = {1,2,3,4,5,6,7,8,9,10,11,12,13,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289,290};
//uint16_t wingMask4[WING_MASK_4_SIZE] = {0,32,33,34,35,39,40,41,51,52,53,54,55,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252,259};
//uint16_t wingMap5[WING_5_SIZE] = {1,2,3,4,5,6,7,8,9,10,11,12,13,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289,290};
//uint16_t wingMask5[WING_MASK_5_SIZE] = {0,32,33,34,40,53,54,56,57,67,68,69,72,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248,249};

bool wing1[NUM_CRYSTALS] = {1,1,1,0,0,0,0,1,1,1,1,0,1,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1,1};
bool wing2[NUM_CRYSTALS] = {1,0,0,0,0,1,1,1,1,1,1,1,1,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1,1};
bool wing3[NUM_CRYSTALS] = {0,0,1,1,1,1,1,1,1,1,1,1,1,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1,1};
bool wing4[NUM_CRYSTALS] = {0,1,1,1,1,1,1,1,1,1,1,1,1,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1,1};
bool wing5[NUM_CRYSTALS] = {0,1,1,1,1,1,1,1,1,1,1,1,1,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1,1};

Graph * g;
int *dist;

// Time variables
uint8_t t = 0;
uint8_t timer = 0;
uint8_t timeDelta = 3;

// HSV variables 
// NOTE: uint8_t allows you to have a range 0-255 without having to mod any values (via 8-bit overflow)
uint8_t hue = 0;
uint8_t hueDelta = 1;

void setup() {

  // Initialises all ports as outputs (0 for output, 1 for input)
  // pins  0  ->  7
  DDRD = 0b00000000;
  // pins  8  -> 13
  DDRB = 0b00000000;
  // pins  14 -> 21
  DDRC = 0b00000000;
  Serial.begin(9600);

  FastLED.addLeds<LED_TYPE, DATA_PIN0, RGB> (leds, 0, LEDS_PER_PIN);
//  FastLED.addLeds<LED_TYPE, DATA_PIN1, RGB> (leds, LEDS_PER_PIN, 40);
  // https://github.com/FastLED/FastLED/wiki/Multiple-Controller-Examples
//   FastLED.addLeds<LED_TYPE, DATA_PIN2, RGB> (leds, 2*LEDS_PER_PIN, LEDS_PER_PIN);

  g = new Graph();
  srand(0);
  FastLED.setBrightness(BRIGHTNESS);
}

void loop() {
  
// Measures execution time
//--------------------------------
  unsigned long duration = micros();
  float total = 0;
//--------------------------------


  dist = g->calcDist(259);


  // Sample shimmering centric gradient code
  for(int i = 0; i < NUM_CRYSTALS; i++) {
    if(wing1[i]) {
      double hue = ((float)dist[i]/50)*255 + t;
      if(hue >= 255) hue = hue - 255;
      crystalHSV(i, hue, (float)(rand()%21)/100+0.8, (1-(float)dist[i]/14)*((float)timer));
      
      // IF YOU CAN'T GET SENSORS TO WORK, just use this test code
      // crystalHSV(i, hue, (float)(rand()%21)/100+0.8, 1-(float)dist[i]/14);

    } else {
      // Turns off other crystals
      crystalHSV(i, 0, 0, 0);
    }
  }

  // Counts how long the sensors have been active for
  if(!digitalRead(SENSOR0)) {
    if(timer != 255) timer += timeDelta;
  } else {
    if(timer != 0) timer -= timeDelta;
  }
  
  t++;
  if(!digitalRead(SENSOR0)) hue += hueDelta;
//  FastLED.delay(10);
  FastLED.show();

  delete[] dist;


// Measures execution time
//--------------------------------
  duration = micros() - duration;
  total += duration;
  Serial.print("\nTime per loop: ");
  Serial.print(total);
  Serial.println(" microseconds");
  Serial.print("FPS: ");
  Serial.println(1000000/(float)total);
//--------------------------------

// Measures RAM usage
//--------------------------------
  int ramUsage = 196608 - freeRAM() + mallinfo().uordblks;
  Serial.print("Ram usage: ");
  Serial.print((float)ramUsage/196608 * 100);
  Serial.print("% | ");
  Serial.print(ramUsage);
  Serial.println("/196608 bytes");
//--------------------------------

  Serial.print("Sensor status: ");
  Serial.print(digitalRead(0));
  Serial.println(digitalRead(17));
  
  
//  for(i = 0; i < NUM_CRYSTALS; i++) {
//    int red = rand() % 255, blue = rand() % 255, green = rand() % 255;
//    colourCrystal(i, red, blue, green);
//  }
}

void crystalRGB(int index, int r, int g, int b) {
  for (int i = firstLED[index]; i <= lastLED[index]; i++) leds[i] = CRGB(r, g, b);
}

void crystalHSV(int index, int h, int s, int v) {
  for (int i = firstLED[index]; i <= lastLED[index]; i++) leds[i].setHSV(h, s, v);
}

uint32_t freeRAM(){ // for Teensy 3.0
    uint32_t stackTop;
    uint32_t heapTop;

    // current position of the stack.
    stackTop = (uint32_t) &stackTop;

    // current position of heap.
    void* hTop = malloc(1);
    heapTop = (uint32_t) hTop;
    free(hTop);

    // The difference is the free, available ram.
    return stackTop - heapTop;
}
