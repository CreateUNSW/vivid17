#ifdef __cplusplus
extern "C" {
#endif
int _isatty (){
  return 0;
}
int _fstat (){
  return 1;
}
#ifdef __cplusplus
}
#endif
#include "malloc.h"

#include "FastLED.h"
#include "Graph.hpp"


// IO/Hardware config
//--------------------------------------------------
#define RIGHT_GREEN 2
#define RIGHT_YELLOW 7
#define RIGHT_PINK 8
#define RIGHT_BLUE 14
#define LEFT_GREEN 5
#define LEFT_YELLOW 6
#define LEFT_PINK 20
#define LEFT_BLUE 21

#define RG_INDEX 0
#define RY_INDEX 172
#define RP_INDEX 352
#define RB_INDEX 510
#define LB_INDEX 755
#define LP_INDEX 1029
#define LY_INDEX 1193
#define LG_INDEX 1372+3
#define MAX_LED_NUM 1548
#define CLOCK_PIN 13

#define SENSOR0 0

#define LED_TYPE UCS1903
#define BRIGHTNESS 100
//--------------------------------------------------


// Crystals/LEDs config
//--------------------------------------------------
#define NUM_CRYSTALS 291
//--------------------------------------------------


CRGB leds[1600];

uint16_t firstLED[291] = {0,5,10,13,16,21,27,33,40,45,48,54,58,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1536,1543};
uint16_t lastLED[291] = {4,9,12,15,20,26,32,39,44,47,53,57,66,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1542,1549};

bool wing1[NUM_CRYSTALS] = {1,1,1,0,0,0,0,1,1,1,1,0,1,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1,1};
bool wing2[NUM_CRYSTALS] = {1,0,0,0,0,1,1,1,1,1,1,1,1,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1,1};
bool wing3[NUM_CRYSTALS] = {0,0,1,1,1,1,1,1,1,1,1,1,1,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1,1};
bool wing4[NUM_CRYSTALS] = {0,1,1,1,1,1,1,1,1,1,1,1,1,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1,1};
bool wing5[NUM_CRYSTALS] = {0,1,1,1,1,1,1,1,1,1,1,1,1,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1,1};

Graph * g;
int *dist;

// Time variables
uint8_t t = 0;
uint8_t timer = 0;
uint8_t timeDelta = 3;

// HSV variables 
// NOTE: uint8_t allows you to have a range 0-255 without having to mod any values (via 8-bit overflow)
uint8_t hue = 0;
uint8_t hueDelta = 1;

void setup() {
  Serial.begin(9600);
  FastLED.addLeds<LED_TYPE, RIGHT_GREEN, RGB>(leds, RG_INDEX, 172);
  FastLED.addLeds<LED_TYPE, RIGHT_YELLOW, RGB>(leds, RY_INDEX, 180);
  FastLED.addLeds<LED_TYPE, RIGHT_PINK, RGB> (leds, RP_INDEX, 158);
  FastLED.addLeds<LED_TYPE, RIGHT_BLUE, RGB> (leds, RB_INDEX, 245);
  FastLED.addLeds<LED_TYPE, LEFT_BLUE, RGB> (leds, LB_INDEX, 274);
  FastLED.addLeds<LED_TYPE, LEFT_PINK, RGB> (leds, LP_INDEX, 164);
  FastLED.addLeds<LED_TYPE, LEFT_YELLOW, RGB> (leds, LY_INDEX, 179+2);
  FastLED.addLeds<LED_TYPE, LEFT_GREEN, RGB> (leds, LG_INDEX, 176);

  g = new Graph();
  srand(0);
  FastLED.setBrightness(BRIGHTNESS);
}

void loop() {
  
// Measures execution time
//--------------------------------
  unsigned long duration = micros();
  float total = 0;
//--------------------------------


  dist = g->calcDist(259);

  for(int i = 0; i < NUM_CRYSTALS; i++) {
    if(wing1[i] == 0) {
      crystalHSV(i, 0, 255, 100);
    } else {
      crystalHSV(i, 0, 1, 0);
    }
  }
  
  // Counts how long the sensors have been active for
  if(!digitalRead(SENSOR0)) {
    if(timer != 255) timer += timeDelta;
  } else {
    if(timer != 0) timer -= timeDelta;
  }
  
  t++;
  if(!digitalRead(SENSOR0)) hue += hueDelta;
  FastLED.show();
  delete[] dist;


// Measures execution time
//--------------------------------
  duration = micros() - duration;
  total += duration;
  Serial.print("\nTime per loop: ");
  Serial.print(total);
  Serial.println(" microseconds");
  Serial.print("FPS: ");
  Serial.println(1000000/(float)total);
//--------------------------------

// Measures RAM usage
//--------------------------------
  int ramUsage = 196608 - freeRAM() + mallinfo().uordblks;
  Serial.print("Ram usage: ");
  Serial.print((float)ramUsage/196608 * 100);
  Serial.print("% | ");
  Serial.print(ramUsage);
  Serial.println("/196608 bytes");
//--------------------------------

  Serial.print("Sensor status: ");
  Serial.print(digitalRead(0));
  Serial.println(digitalRead(17));
  
  
//  for(i = 0; i < NUM_CRYSTALS; i++) {
//    int red = rand() % 255, blue = rand() % 255, green = rand() % 255;
//    colourCrystal(i, red, blue, green);
//  }
}

void crystalRGB(int index, int r, int g, int b) {
  for (int i = firstLED[index]; i <= lastLED[index]; i++) leds[i] = CRGB(r, g, b);
}

void crystalHSV(int index, int h, int s, int v) {
  for (int i = firstLED[index]; i <= lastLED[index]; i++) leds[i].setHSV(h, s, v);
}

uint32_t freeRAM(){ // for Teensy 3.0
    uint32_t stackTop;
    uint32_t heapTop;

    // current position of the stack.
    stackTop = (uint32_t) &stackTop;

    // current position of heap.
    void* hTop = malloc(1);
    heapTop = (uint32_t) hTop;
    free(hTop);

    // The difference is the free, available ram.
    return stackTop - heapTop;
}
